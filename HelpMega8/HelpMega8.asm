
.device avrmega8	;Наш девайс ATmega8.

.nolist

.include "C:\Program Files\Atmel\AVR Tools\AvrAssembler2\Appnotes\m8def.inc"	;Фаил включений.
.list

rjmp Init			;Переход на процедуру инициализации. 


;**********************************************************************************************

;Объявляем организацию памяти.
;Инициализируем вектора прерываний.

.org 0x0001				;Арес вектора "Внешнее прерывание 0".
	rjmp INT_0			;Переход на метку обработчика преравания INT0.


.org 0x0002				;Арес вектора "Внешнее прерывание 1".
	rjmp INT_1			;Переход на метку обработчика преравания INT0.


.org 0x0003				;Арес вектора "Совпадение таймера/счетчика Т2".
	rjmp TIMER2COMP		;Переход на метку обработчика преравания TIMER2 COMP.


.org 0x0004				;Арес вектора "Переполнение таймера/счетчика Т2".
	rjmp TIMER2OVF		;Переход на метку обработчика преравания TIMER2 OVF.

.org 0x0005				;Арес вектора "Звхват таймера/счетчика T1".
	rjmp TIMER1CAPT		;Переход на метку обработчика преравания TIMER1 CAPT.


.org 0x0006				;Арес вектора "Совпадение A таймера/счетчика Т1".
	rjmp TIMER1COMPA	;Переход на метку обработчика преравания TIMER1 COMPA.


.org 0x0007				;Арес вектора "Совпадение B таймера/счетчика Т1".
	rjmp TIMER1COMPB	;Переход на метку обработчика преравания TIMER1 COMPB.


.org 0x0008				;Арес вектора "Переполнение таймера/счетчика Т1".
	rjmp TIMER1OVF		;Переход на метку обработчика преравания TIMER1 OVF.


.org 0x0009				;Арес вектора "Переполнение таймера/счетчика Т0".
	rjmp TIMER0OVF		;Переход на метку обработчика преравания TIMER0 OVF.


.org 0x000A				;Арес вектора "Передача по SPI завершена".
	rjmp SPI_STC		;Переход на метку обработчика преравания SPI, STC.


.org 0x000B				;Арес вектора "USART, прием завершен".
	rjmp USART_RXC		;Переход на метку обработчика преравания USART, RXC.


.org 0x000C				;Арес вектора "Регист данных USART, пуст".
	rjmp USART_UDRE		;Переход на метку обработчика преравания USART, UDRE.


.org 0x000D				;Арес вектора "USART, передача завершена".
	rjmp USART_TXC		;Переход на метку обработчика преравания USART, TXC.


.org 0x000E				;Арес вектора "Преобразование АЦП завершено".
	rjmp ANDICON		;Переход на метку обработчика преравания ADC.

.org 0x000F				;Арес вектора "EEPROM готово".
	rjmp EE_RDY			;Переход на метку обработчика преравания EE_RDY.

.org 0x0010				;Арес вектора "Аналоговый компаратор".
	rjmp ANA_COMP		;Переход на метку обработчика преравания ANA_COMP.

.org 0x0011				;Арес вектора "Прерывание от модуля TWI".
	rjmp TWI			;Переход на метку обработчика преравания TWI.

.org 0x0012				;Арес вектора "Готовность SPM".
	rjmp SPM_RDY			;Переход на метку обработчика преравания SPM_RDY.

.org 0x0014			;Переход по адресу $0014. Программа начнётся с этого адреса.
					;Вектора прерываний у Меги8 заканчиваются на $0012 адресе.


;**********************************************************************************************
;**********************************************************************************************


Init:				;Процедура инициализации.

;Инициализируем стек.

ldi R16, low(RAMEND)	;Указуем младшему регистру стека SPL
out SPL, R16			;значение младшего байта верхнего адресса ОЗУ.

ldi R16, high(RAMEND)	;Указуем старшему регистру стека SPH
out SPH, R16			;значение старшего байта верхнего адресса ОЗУ.

;****************************************************

;Конфигурим Порты I/O.

ldi R16, 0	;Конфигурим ПортВ на входы и выходы.
out DDRB, R16		;
		

ldi R16, 0	;Конфигурим ПортВ на начальные включения для выходов и подтягивающие резисторы для входов.
out PortB, R16		;Все состояния порта B будут отключены.

;****************************************************

ldi R16, 0b00100000	;Конфигурим ПортС на входы и выходы.
out DDRC, R16		;!!!7 бит порта С незадейсивован.
		

ldi R16, 0b00000000	;Конфигурим ПортС на начальные включения для выходов и подтягивающие резисторы для входов.
out PortC, R16		;Все состояния порта С будут отключены.

;****************************************************

ldi R16, 0	;Конфигурим ПортD на входы и выходы.
out DDRD, R16		;

ldi R16, 0	;Конфигурим ПортD на начальные включения для выходов и подтягивающие резисторы для входов.
out PortD, R16		;Все состояния порта D будут отключены.


;**********************************************************************************************

;Настрайваем АЦП.

sei					;Разрешаем прерывания. Это нужно для настройки АЦП.

ldi R16, 0b00000000	;Конфигурим АЦП. Включаем его 7 битом и
out ADCSRA, R16		;выбираем его рабочию тактовую частоту в соответствии:
									;0bxxxxx000 - Коэффициент деления 2. clkADC=clkIO/2;
									;0bxxxxx001 - Коэффициент деления 2. clkADC=clkIO/2;
									;0bxxxxx010 - Коэффициент деления 4. clkADC=clkIO/4;
									;0bxxxxx011 - Коэффициент деления 8. clkADC=clkIO/8;
									;0bxxxxx100 - Коэффициент деления 16. clkADC=clkIO/16;
									;0bxxxxx101 - Коэффициент деления 32. clkADC=clkIO/32;
									;0bxxxxx110 - Коэффициент деления 64. clkADC=clkIO/64;
									;0bxxxxx111 - Коэффициент деления 128. clkADC=clkIO/128.

ldi R16, 0b00000000	;Конфигурим АЦП. Выбираем номер калала АЦП.
out ADMUX, R16

cli					;Снова запрещаем все прерывания.

;**********************************************************************************************

;Конфигурим таймер Т0. 

ldi R16, 0b00000000	;Конфигурим таймер T0 на
out TCCR0, R16		;тактовую частоту в соответствии:
									;0bxxxxx000 - Таймер/счетчик остановлен;
									;0bxxxxx001 - системный тактовый сигнал clkT=clkIO;
									;0bxxxxx010 - clkT=clkIO/8;
									;0bxxxxx011 - clkT=clkIO/64;
									;0bxxxxx100 - clkT=clkIO/256;
									;0bxxxxx101 - clkT=clkIO/1024;
									;0bxxxxx110 - clkT=clkIO/256 Вывод T0, счет по спад. фронту;
									;0bxxxxx111 - clkT=clkIO/1024 Вывод T0, счет по нараст. фронту.


;**********************************************************************************************

;Конфигурим таймер Т1. 

ldi R16, 0b00000000	;Конфигурим таймер T1 на режим работы и 
out TCCR1B, R16		;тактовую частоту в соответствии:
									;0bxxxxx000 - Таймер/счетчик остановлен;
									;0bxxxxx001 - системный тактовый сигнал clkT=clkIO;
									;0bxxxxx010 - clkT=clkIO/8;
									;0bxxxxx011 - clkT=clkIO/64;
									;0bxxxxx100 - clkT=clkIO/256;
									;0bxxxxx101 - clkT=clkIO/1024;
									;0bxxxxx110 - clkT=clkIO/256 Вывод T1, счет по спад. фронту;
									;0bxxxxx111 - clkT=clkIO/1024 Вывод T1, счет по нараст. фронту.

;**********************************************************************************************

;Конфигурим таймер Т2. 

ldi R16, 0b00000000	;Конфигурим таймер T2 на режим работы и 
out TCCR2, R16		;тактовую частоту в соответствии:
									;0bxxxxx000 - Таймер/счетчик остановлен;
									;0bxxxxx001 - системный тактовый сигнал clkT=clkIO;
									;0bxxxxx010 - clkT=clkIO/8;
									;0bxxxxx011 - clkT=clkIO/64;
									;0bxxxxx100 - clkT=clkIO/256;
									;0bxxxxx101 - clkT=clkIO/1024;
									;0bxxxxx110 - clkT=clkIO/256 Вывод T2, счет по спад. фронту;
									;0bxxxxx111 - clkT=clkIO/1024 Вывод T2, счет по нараст. фронту.

;**********************************************************************************************

ldi R16, 0b00000000	;Конфигурим регист управления
out TIMSK, R16		;прерыванием от таймеров/счетчиков в соответствии:
									;7бит - Переполнение таймера Т2;
									;6бит - Совпадение таймера Т2;
									;5бит - Захват таймера T1;
									;4бит - Совпадение A таймера Т1;
									;3бит - Совпадение B таймера Т1;
									;2бит - Переполнение таймера Т1;
									;1бит - неиспользуется;
									;0бит - Переполнение таймера Т0.

;*********************************************************************************************
;Конфигурим сторожевой таймер WATCHDOG.

ldi R16, 0b00011000	;Включаем сторожевой таймер записью бита WDCE-разрешение изменения конфигурации
out WDTCR, R16		;и бита WDE-разрешение сторожевого таймера (1-включить).

wdr					;Сбрасываем сторожевой таймер перед конфигурацией битов WDP.

ldi R16, 0b00011111	;Настраиваем период тайм-аута старожевого таймера
out WDTCR, R16		;на частоту в соответствии:
									;0bxxxxx000 - 16.3мс.	(17.3мс.);
									;0bxxxxx001 - 32.5мс.	(34.3мс.);
									;0bxxxxx010 - 65мс.		(68.5мс.);
									;0bxxxxx011 - 130мс.	(140мс.);
									;0bxxxxx100 - 260мс.	(270мс.);
									;0bxxxxx101 - 520мс.	(550мс.);
									;0bxxxxx110 - 1000мс.	(1100мс.);
									;0bxxxxx111 - 2100мс.	(2200мс.).

					;Данные типовые значения соответствуют Vcc=5В.
					;При Vcc=3В типовые значения приведены в скобках.

;*********************************************************************************************

;Начало Рабочей процедуры.

Start: 				;Рабочая процедура.

sei					;Разрешаем прерывания. Следующая за SEI инструкция будет выполнена
					;перед отработкой любого отложенного прерывания.

wdr					;Сбрасываем сторожевой таймер.


rjmp Start			;В начало.

;*********************************************************************************************

;****************************************************

INT_0:			;Программа обработчик "Внешнего прерывание 0".
cli				;На время выполнения прерывания запретим другие прерывания.
				
				
rjmp Start		;Возвращаемся к Рабочеи процедуре.

;****************************************************

INT_1:			;Программа обработчик "Внешнего прерывание 1".
cli				;На время выполнения прерывания запретим другие прерывания.
				
				
rjmp Start		;Возвращаемся к Рабочеи процедуре.

;****************************************************

TIMER2COMP:		;Программа обработчик "Совпадение таймера T2".
cli				;На время выполнения прерывания запретим другие прерывания.
				
				
rjmp Start		;Возвращаемся к Рабочеи процедуре.

;****************************************************

TIMER2OVF:		;Программа обработчик "Переполнение таймера T2".
cli				;На время выполнения прерывания запретим другие прерывания.
				
				
rjmp Start		;Возвращаемся к Рабочеи процедуре.

;****************************************************

TIMER1CAPT:		;Программа обработчик "Захват таймера T1".
cli				;На время выполнения прерывания запретим другие прерывания.
				
				
rjmp Start		;Возвращаемся к Рабочеи процедуре.

;****************************************************

TIMER1COMPA:	;Программа обработчик "Совпадение A таймера T1".
cli				;На время выполнения прерывания запретим другие прерывания.
				
				
rjmp Start		;Возвращаемся к Рабочеи процедуре.

;****************************************************

TIMER1COMPB:	;Программа обработчик "Совпадение B таймера T1".
cli				;На время выполнения прерывания запретим другие прерывания.
				
				
rjmp Start		;Возвращаемся к Рабочеи процедуре.

;****************************************************

TIMER1OVF:		;Программа обработчик "Переполнение таймера T1".
cli				;На время выполнения прерывания запретим другие прерывания.
				
				
rjmp Start		;Возвращаемся к Рабочеи процедуре.

;****************************************************

TIMER0OVF:		;Программа обработчик "Переполнение таймера T0".
cli				;На время выполнения прерывания запретим другие прерывания.
				
				
rjmp Start		;Возвращаемся к Рабочеи процедуре.

;****************************************************

SPI_STC:		;Программа обработчик "Передача по SPI завершена".
cli				;На время выполнения прерывания запретим другие прерывания.
				
				
rjmp Start		;Возвращаемся к Рабочеи процедуре.

;****************************************************

USART_RXC:		;Программа обработчик "USART, прием завершен".
cli				;На время выполнения прерывания запретим другие прерывания.
				
				
rjmp Start		;Возвращаемся к Рабочеи процедуре.

;****************************************************

USART_UDRE:		;Программа обработчик "Регистр данных USART пуст".
cli				;На время выполнения прерывания запретим другие прерывания.
				
				
rjmp Start		;Возвращаемся к Рабочеи процедуре.

;****************************************************

USART_TXC:		;Программа обработчик "USART, передача завершена".
cli				;На время выполнения прерывания запретим другие прерывания.
				
				
rjmp Start		;Возвращаемся к Рабочеи процедуре.

;****************************************************

ANDICON:		;Программа обработчик "Преобразование АЦП завершено".
cli				;На время выполнения прерывания запретим другие прерывания.
				
				
rjmp Start		;Возвращаемся к Рабочеи процедуре.

;****************************************************

EE_RDY:			;Программа обработчик "Готовность EEPROM".
cli				;На время выполнения прерывания запретим другие прерывания.
				
				
rjmp Start		;Возвращаемся к Рабочеи процедуре.

;****************************************************

ANA_COMP:		;Программа обработчик "Аналоговый компаратор".
cli				;На время выполнения прерывания запретим другие прерывания.
				
				
rjmp Start		;Возвращаемся к Рабочеи процедуре.

;****************************************************

TWI:			;Программа обработчик "Прерывание от модуля TWI".
cli				;На время выполнения прерывания запретим другие прерывания.
				
				
rjmp Start		;Возвращаемся к Рабочеи процедуре.

;****************************************************

SPM_RDY:		;Программа обработчик "Готовность SPM".
cli				;На время выполнения прерывания запретим другие прерывания.
				
				
rjmp Start		;Возвращаемся к Рабочеи процедуре.

;****************************************************
;*********************************************************************************************

.eseg	;Переходим в запись EEPROM.

;Распологаем с нулевого адреса справочную информацию.
.db 'A','v','t','o','r',':',' ',' ','O','r','f','a','n','i','d','i'
.db 'P','r','o','g','.','D','a','t','a',':',' ','0','4','.','1','1'
.db 'H','a','r','d','.','D','a','t','a',':',' ','0','4','.','1','1'
.db 'P','r','o','g','.','V','e','r','.',':',' ','0','1','.','0','1'
.db 'H','a','r','d','.','V','e','r','.',':',' ','0','1','.','0','1'
.db 'D','e','v','i','c','e',':',' ',' ','A','T','m','e','g','a','8'
.db 'F','r','e','q','.',':',' ',' ',' ',' ','1','.','0','M','H','z'
.db 'S','N',':',' ',' ',' ',' ',' ','0','0','-','0','0','-','0','0'
.db 'C','o','m','m','e','n','t','s',':',' ',' ',' ',' ',' ',' ','.'
.db ' ',' ',' ',' ','.',' ',' ',' ',' ','.',' ',' ',' ',' ',' ','.'
.db ' ',' ',' ',' ',' ',' ',' ',' ',' ',' ',' ',' ','.','E','N','D'

;*********************************************************************************************

;*END*END*END*END*END*END*END*END*END*END*END*END*END*END*END*END*END*END*END*END*END*END*END*

