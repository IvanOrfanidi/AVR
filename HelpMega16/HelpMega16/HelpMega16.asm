
.device avrmega16	;Наш девайс ATmega16.

.nolist

.include "C:\Program Files\Atmel\AVR Tools\AvrAssembler2\Appnotes\m16def.inc"	;Фаил включений.
.list


#define CPU_freq 2000000		//Frequency CPU.

rjmp Init			;Переход на процедуру инициализации. 


;**********************************************************************************************

;Объявляем организацию памяти.
;Инициализируем вектора прерываний.
;ВНИМАНИЕ!!! Данная инициализация векторов прерывания при незапрограммированном BOOTRST. 

.org 0x0000				;Адрес вектора "Сброс".
	jmp RESET

.org 0x0002				;Адрес вектора "Внешнее прерывание 0".
	jmp EXT_INT0


.org 0x0004				;Адрес вектора "Внешнее прерывание 1".
	jmp EXT_INT1		


.org 0x0006				;Адрес вектора "Совпадение таймера/счетчика Т2".
	jmp TIM2_COMP		


.org 0x0008				;Адрес вектора "Переполнение таймера/счетчика Т2".
	jmp TIM2_OVF		


.org 0x000A				;Адрес вектора "Звхват таймера/счетчика T1".
	jmp TIM1_CAPT		


.org 0x000C				;Адрес вектора "Совпадение A таймера/счетчика Т1".
	jmp TIM1_COMPA


.org 0x000E				;Адрес вектора "Совпадение B таймера/счетчика Т1".
	jmp TIM1_COMPB		


.org 0x0010				;Адрес вектора "Переполнение таймера/счетчика Т1".
	jmp TIM1_OVF		


.org 0x0012				;Адрес вектора "Переполнение таймера/счетчика Т0".
	jmp TIM0_OVF		


.org 0x0014				;Адрес вектора "Передача по SPI завершена".
	jmp SPI_STC	


.org 0x0016				;Адрес вектора "USART, прием завершен".
	jmp USART_RXC		


.org 0x0018				;Адрес вектора "Регист данных USART, пуст".
	jmp USART_UDRE		


.org 0x001A				;Адрес вектора "USART, передача завершена".
	jmp USART_TXC		


.org 0x001C				;Адрес вектора "Преобразование АЦП завершено".
	jmp ANDICON		


.org 0x001E				;Адрес вектора "EEPROM готово".
	jmp EE_RDY			


.org 0x0020				;Адрес вектора "Аналоговый компаратор".
	jmp ANA_COMP		


.org 0x0022				;Адрес вектора "Прерывание от модуля TWI".
	jmp TWSI			


.org 0x0024				;Адрес вектора "Внешнее прерывание 2".
	jmp EXT_INT2		


.org 0x0026				;Адрес вектора "Совпадение таймера/счетчика Т0".
	jmp TIM0_COMP		


.org 0x0028				;Адрес вектора "Готовность SPM".
	jmp SPM_RDY			


.org 0x0030			;Переход по адресу $0030. Программа начнётся с этого адреса.
					;Вектора прерываний у Меги16 заканчиваются на $0028 адресе.


;**********************************************************************************************
;**********************************************************************************************


Init:				;Процедура инициализации.

;Инициализируем стек.

ldi R16, high(RAMEND)	;Указуем старшему регистру стека SPH
out SPH, R16			;значение старшего байта верхнего адресса ОЗУ.

ldi R16, low(RAMEND)	;Указуем младшему регистру стека SPL
out SPL, R16			;значение младшего байта верхнего адресса ОЗУ.

;****************************************************


;Конфигурим Порты I/O.

ldi R16, 0b00000000	;Конфигурим ПортA на входы и выходы.
out DDRA, R16		;
		

ldi R16, 0b00000000	;Конфигурим ПортA на начальные включения для выходов и подтягивающие резисторы для входов.
out PortA, R16		;Все состояния порта A будут отключены.

;****************************************************

ldi R16, 0b00000000	;Конфигурим ПортВ на входы и выходы.
out DDRB, R16		;
		

ldi R16, 0b00000000	;Конфигурим ПортВ на начальные включения для выходов и подтягивающие резисторы для входов.
out PortB, R16		;Все состояния порта B будут отключены.

;****************************************************

ldi R16, 0b00000000	;Конфигурим ПортС на входы и выходы.
out DDRC, R16		
		

ldi R16, 0b00000000	;Конфигурим ПортС на начальные включения для выходов и подтягивающие резисторы для входов.
out PortC, R16		;Все состояния порта С будут отключены.

;****************************************************

ldi R16, 0b00000000	;Конфигурим ПортD на входы и выходы.
out DDRD, R16		;

ldi R16, 0b00000000	;Конфигурим ПортD на начальные включения для выходов и подтягивающие резисторы для входов.
out PortD, R16		;Все состояния порта D будут отключены.


;**********************************************************************************************

//INIT ANALOG COMPARATOR//

LDI R16, (1<<ACD);		//Disable Analog Comparator.
OUT ACSR, R16;

/////////////////////////////////////////////////////////////////////

;Настрайваем АЦП.

clr R17

sei					;Разрешаем прерывания. Это нужно для настройки АЦП.

ldi R16, (0<<ADEN)	;Включаем АЦП битом ADEN.
or R17, R16			


ldi R16, (1<<ADPS2)|(1<<ADPS1)|(1<<ADPS0);Конфигурим АЦП, выбираем его
or R17, R16								;рабочию тактовую частоту в соответствии:
									;# ADSP2 # ADSP1 # ADSP0 #  Коэфициент деления #
									;#   0   #   0   #   0   #  fclkADC=fclkIO/2   #
									;#   0   #   0   #   1   #  fclkADC=fclkIO/2   #
									;#   0   #   1   #   0   #  fclkADC=fclkIO/4   #
									;#   0   #   1   #   1   #  fclkADC=fclkIO/8   #
									;#   1   #   0   #   0   #  fclkADC=fclkIO/16  #
									;#   1   #   0   #   1   #  fclkADC=fclkIO/32  #
									;#   1   #   1   #   0   #  fclkADC=fclkIO/64  #
									;#   1   #   1   #   1   #  fclkADC=fclkIO/128 #
									;***********************************************

out ADCSRA, R17		;Заносим конечную конфигурацию в регист ADCSRA.
clr R17					


	;Конфигурим регист ADMUX

ldi R16, (0<<REFS1)|(0<<REFS0) 	;Выбираем источник опорного 
or R17, R16							;напряжения в соответствии:
									;# REFS1 # REFS0 # Источник опроного напряжения   #
									;#   0   #   0   #  ARef источник опорногоо напр. #
									;#   0   #   1   #	AVcc источник опорногоо напр. #
									;#   1   #   0   #			Зарезервированно      #
									;#   1   #   1   #   Внутренний источник 2.56В	  #
									;**************************************************

ldi R16, (0<<ADLAR)				;Выбираем выравнивание регистра ADC, 
or R17, R16							;при 0 - выравнивание в лево (10bit),
									;при 1 - выравнивание в право (8bit).
				
ldi R16, (0<<MUX4)|(0<<MUX3)|(0<MUX2)|(0<<MUX1)|(0<<MUX0) ; Выбираем номер канала АЦП
or R17, R16													;в соответствии:
		;# MUX4 # MUX3 # MUX2 # MUX1 # MUX0 # Вход АЦП # Позитивный диф. вход # Негативный диф. вход # Коэф. усиления #
		;#  0   #  0   #  0   #  0   #  0   #   ADC0   #        N/A           #         N/A          #      N/A       #
		;#  0   #  0   #  0   #  0   #  1   #   ADC1   #        N/A           #         N/A          #      N/A       #
		;#  0   #  0   #  0   #  1   #  0   #   ADC2   #        N/A           #         N/A          #      N/A       #
		;#  0   #  0   #  0   #  1   #  1   #   ADC3   #        N/A           #         N/A          #      N/A       #
		;#  0   #  0   #  1   #  0   #  0   #   ADC4   #        N/A           #         N/A          #      N/A       #
		;#  0   #  0   #  1   #  0   #  1   #   ADC5   #        N/A           #         N/A          #      N/A       #
		;#  0   #  0   #  1   #  1   #  0   #   ADC6   #        N/A           #         N/A          #      N/A       #
		;#  0   #  0   #  1   #  1   #  1   #   ADC7   #        N/A           #         N/A          #      N/A       #
		;#  0   #  1   #  0   #  0   #  0   #   N/A    #        ADC0          #         ADC0         #      10x       #
		;#  0   #  1   #  0   #  0   #  1   #   N/A    #        ADC1          #         ADC0         #      10x       #
		;#  0   #  1   #  0   #  1   #  0   #   N/A    #        ADC0          #         ADC0         #     200x       #
		;#  0   #  1   #  0   #  1   #  1   #   N/A    #        ADC1          #         ADC0         #     200x       #
		;#  0   #  1   #  1   #  0   #  0   #   N/A    #        ADC2          #         ADC2         #      10x       #
		;#  0   #  1   #  1   #  0   #  1   #   N/A    #        ADC3          #         ADC2         #      10x       #
		;#  0   #  1   #  1   #  1   #  0   #   N/A    #        ADC2          #         ADC2         #     200x       #
		;#  0   #  1   #  1   #  1   #  1   #   N/A    #        ADC3          #         ADC2         #     200x       #
		;#  1   #  0   #  0   #  0   #  0   #   N/A    #        ADC0          #         ADC1         #      1x        #
		;#  1   #  0   #  0   #  0   #  1   #   N/A    #        ADC1          #         ADC1         #      1x        #
		;#  1   #  0   #  0   #  1   #  0   #   N/A    #        ADC2          #         ADC1         #      1x        #
		;#  1   #  0   #  0   #  1   #  1   #   N/A    #        ADC3          #         ADC1         #      1x        #
		;#  1   #  0   #  1   #  0   #  0   #   N/A    #        ADC4          #         ADC1         #      1x        #
		;#  1   #  0   #  1   #  0   #  1   #   N/A    #        ADC5          #         ADC1         #      1x        #
		;#  1   #  0   #  1   #  1   #  0   #   N/A    #        ADC6          #         ADC1         #      1x        #
		;#  1   #  0   #  1   #  1   #  1   #   N/A    #        ADC7          #         ADC1         #      1x        #
		;#  1   #  1   #  0   #  0   #  0   #   N/A    #        ADC0          #         ADC2         #      1x        #
		;#  1   #  1   #  0   #  0   #  1   #   N/A    #        ADC1          #         ADC2         #      1x        #
		;#  1   #  1   #  0   #  1   #  0   #   N/A    #        ADC2          #         ADC2         #      1x        #
		;#  1   #  1   #  0   #  1   #  1   #   N/A    #        ADC3          #         ADC1         #      1x        #
		;#  1   #  1   #  1   #  0   #  0   #   N/A    #        ADC4          #         ADC1         #      1x        #
		;#  1   #  1   #  1   #  0   #  1   #   N/A    #        ADC5          #         ADC1         #      1x        #
		;#  1   #  1   #  1   #  1   #  0   #1.22V(Vbg)#        N/A           #         N/A          #      N/A       #
		;#  1   #  1   #  1   #  1   #  1   # 0V (GND) #        N/A           #         N/A          #      N/A       #
		;**********************************************************************

out ADMUX, R17 ;Заносим конечную конфигурацию в регист ADMUX.
clr R17

	;Конфигурим специальный регист SFIOR.

ldi R16, (0<<ADTS2)|(0<<ADTS1)|(0<<ADTS0)
or R17, R16

out SFIOR, R17	;Заносим конфигурацию  в регист SFIOR
clr R17

cli					;Снова запрещаем все прерывания.

;**********************************************************************************************

;Конфигурим таймер Т0. 

ldi R17, (0<<CS02)|(0<<CS01)|(0<<CS00)	;Конфигурим таймер T0 на режим работы и 
or R17, R16							;тактовую частоту в соответствии:
										;# CS02 # CS01 # CS00 # 				Частота таймера T1  			#
										;#   0  #   0  #   0  # 		Таймер/счетчик остановлен				#
										;#   0  #   0  #   1  # 	clkT=clkIO (систем. такт. сигнал)			#
										;#   0  #   1  #   0  # 				clkT=clkIO/8					#
										;#   0  #   1  #   1  # 				clkT=clkIO/64					#
										;#   1  #   0  #   0  # 				clkT=clkIO/256					#
										;#   1  #   0  #   1  # 				clkT=clkIO/1024					#
										;#   1  #   1  #   0  # clkT=clkIO/256 (Вывод T0 счет по спад. фронту)	#
										;#   1  #   1  #   1  # clkT=clkIO/1024 (Вывод T0 счет по нар. фронту)	#
										;************************************************************************
out TCCR0, R17
clr R17

;**********************************************************************************************

;Конфигурим таймер Т1. 

ldi R17, (0<<CS12)|(0<<CS11)|(0<<CS10)	;Конфигурим таймер T1 на режим работы и 
or R17, R16							;тактовую частоту в соответствии:
										;# CS12 # CS11 # CS10 # 				Частота таймера T1  			#
										;#   0  #   0  #   0  # 		Таймер/счетчик остановлен				#
										;#   0  #   0  #   1  # 	clkT=clkIO (систем. такт. сигнал)			#
										;#   0  #   1  #   0  # 				clkT=clkIO/8					#
										;#   0  #   1  #   1  # 				clkT=clkIO/64					#
										;#   1  #   0  #   0  # 				clkT=clkIO/256					#
										;#   1  #   0  #   1  # 				clkT=clkIO/1024					#
										;#   1  #   1  #   0  # clkT=clkIO/256 (Вывод T1 счет по спад. фронту)	#
										;#   1  #   1  #   1  # clkT=clkIO/1024 (Вывод T1 счет по нар. фронту)	#
										;************************************************************************
out TCCR1B, R17
clr R17

;**********************************************************************************************

;Конфигурим таймер Т2. 

ldi R16, (0<<CS22)|(0<<CS21)|(0<<CS20)	;Конфигурим таймер T2 на режим работы и 
or R17, R16							;тактовую частоту в соответствии:
										;# CS22 # CS21 # CS20 # 				Частота таймера T2  			#
										;#   0  #   0  #   0  # 		Таймер/счетчик остановлен				#
										;#   0  #   0  #   1  # 	clkT=clkIO (систем. такт. сигнал)			#
										;#   0  #   1  #   0  # 				clkT=clkIO/8					#
										;#   0  #   1  #   1  # 				clkT=clkIO/32					#
										;#   1  #   0  #   0  # 				clkT=clkIO/64					#
										;#   1  #   0  #   1  # 				clkT=clkIO/128					#
										;#   1  #   1  #   0  # 				clkT=clkIO/256				 	#
										;#   1  #   1  #   1  #					clkT=clkIO/1024					#
										;************************************************************************
out TCCR2, R17
clr R17

;**********************************************************************************************

ldi R17, (0<<OCIE2)|(0<<TOIE2)|(0<<TICIE1)|(0<<OCIE1A)|(0<<OCIE1B)|(0<<TOIE1)|(0<<OCIE0)|(0<<TOIE0)	;Конфигурим регист управления
out TIMSK, R17		;прерыванием от таймеров/счетчиков в соответствии:
clr R17								;7бит - (OCIE2) Совпадение таймера Т2;
									;6бит - (TOIE2) Переполнение таймера Т2;
									;5бит - (TICIE1) Захват таймера T1;
									;4бит - (OCIE1A) Совпадение A таймера Т1;
									;3бит - (OCIE1B) Совпадение B таймера Т1;
									;2бит - (TOIE1) Переполнение таймера Т1;
									;1бит - (OCIE0) Совпадение таймера Т0;
									;0бит - (TOIE0) Переполнение таймера Т0.

;*********************************************************************************************

;Конфигурим режим пониженного потребления электропитания.

ldi R16, (1<<SE)	;Разрешаем установкой 6бита (SE) регистра MCUCR
or R17, R16			;перевод МК в режим пониженного энергопотребления.


ldi R16, (0<<SM2)|(0<<SM1)|(0<<SM0)	;Выбираем режим пониженного
or R17, R16							;электропотребления в соответствии:
										;# SM2 # SM1 # SM0 # 		Режим электропотребления  		#
										;#  0  #  0  #  0  # Idle
										;#  0  #  0  #  1  # ADC Noise Reduction
										;#  0  #  1  #  0  # Power Down
										;#  0  #  1  #  1  # Power Save
										;#  1  #  0  #  0  # 			Зарезервировано    	        #
										;#  1  #  0  #  1  # 			Зарезервировано    	        #
										;#  1  #  1  #  0  # Standby (только с внешним резонатором) #
										;#  1  #  1  #  1  # Extended Standby (внешний резонатор)   #
										;************************************************************
out MCUCR, R17
clr R17


;Конфигурим USART.
	
.equ baudrate = 4800						;Скорость порта.
.equ bauddivider = XTAL/(16*baudrate)-1		;Вычисляем значения для регистров UBRRx.

ldi R16, low(bauddivider)		;Заносим нижнее значение скорости USART
out UBRRL, R16					;в регистр UBRRL.

ldi R16, high(bauddivider)		;Заносим верхнее значение скорости USART
out UBRRH, R16					;в регистр UBRRH.

clr R16							;Обнуляем регистр R16 и пересылаем ноль
out UCSRA, R16					;в регист состояния UCSRA.


ldi R16, (0<<RXEN)|(0<<TXEN)|(0<<RXCIE)|(0<<TXCIE)|(0<<UDRIE)		;Конфигурим регистр управления USART в соответствии:
out UCSRB, R16						;7бит - Разрешение прерывание по завершению приёма;
									;6бит - Разрешение прерывание по завершению передачи;
									;5бит - Разрешение прерывание при очистке регистра даннах;
											;!!!ПРИ УСТАНОВКЕ 5БИТА И УСТАНОВКИ ФЛАГА I
											;КОМАНДОЙ sei  ПРОИСХОДИТ АВТОМАТИЧЕСКАЯ
											;ГЕНЕРАЦИЯ ПРЕРЫВАНИЯ И ПЕРЕХОД НА ЕЁ ВЕКТОР,
											;ТАК КАК РЕГИСТР UART ВНАЧАЛЕ ПУСТ.
									;4бит - Разрешение приёма (функциональный вывод переопределяется);
									;3бит - Разрешение передачи (функциональный вывод переопределяется);
									;2бит - Формат посылок;
									;1бит - 8-й бит принимаемых данных;	
									;0бит - 8-й бит передавемых данных.


ldi R16, (1<<URSEL)|(1<<UCSZ0)|(1<<UCSZ1)
out UCSRC, R16

;*********************************************************************************************
;Конфигурим SPI.

ldi R16, 0b00000000			;Конфигурим регистр управления SPI в соответствии:
out SPCR, R16						;7бит - (SPIE) Разрешение прерывания от SPI;
									;6бит - (SPE) Включение/выключение SPI;
									;5бит - (DORD) Порядок передачи данных,
													;1-первый младший бит байта,
													;0-первый старший бит байта;
									;4бит - (MSTR) Выбор режима работы Master/Slave
													;1-Master МК,
													;0-Slave МК;
									;3бит - (CPOL) Выбор полярности тактового сигнала,
													;1-импульс ОТРИЦАТЕЛЬНЫЙ, на выводе при отсутствии импульсов ВЫСРКИЙ уровень;
													;0-импульс ПОЛОЖИТЕЛЬНЫЙ, на выводе при отсутствии импульсов НИЗКИЙ уровень,
									;2бит - (CPHA) Выбор Фазы тактового сигнала,
													;1-для CPOL=0 по спадающему фронту, для CPOL=1 по нарастающему фронту,
													;0-для CPOL=0 по нарастающему фронту, для CPOL=1 по спадающему фронту;
									;1бит - (SPR1) - Выбор скорости передачи;
									;0бит - (SPR0) - Выбор скорости передачи.

ldi R16, (0<<SPI2X)				;Установка удвоения скорости передачи (SPI2X), либо 0, либо 1,
or R17, R16						;задаём скорость передачи в соответствии:
out SPSR, R17						;# SPI2X # SPR1 # SPR0 # Скорость по шине SPI #
clr R17								;#   0   #  0   #   0  # 	fspi = fclk/4	  #
									;#   0   #  0   #   1  #    fspi = fclk/16 	  #	
									;#   0   #  1   #   0  #	fspi = fclk/64	  #
									;#   0   #  1   #   1  #   	fspi = fclk/128	  #
									;#   1   #  0   #   0  # 	fspi = fclk/2	  #
									;#   1   #  0   #   1  #	fspi = fclk/8	  #
									;#   1   #  1   #   0  #	fspi = fclk/32	  #
									;#   1   #  1   #   1  #	fspi = fclk/64    #
									;**********************************************

;*********************************************************************************************

;Конфигурим сторожевой таймер WATCHDOG.

ldi R16, (0<<WDTOE)|(0<<WDE)	;Включаем сторожевой таймер записью бита WDTOE-разрешение изменения конфигурации
or R17, R16						;и бита WDE-разрешение сторожевого таймера (1-включить).
out WDTCR, R17

wdr					;Сбрасываем сторожевой таймер перед конфигурацией битов WDP.

ldi R16, (0<<WDP2)|(0<<WDP1)|(0<<WDP0)	;Настраиваем период тайм-аута старожевого
or R17, R16							;таймера на частоту в соответствии:
out WDTCR, R17							;# WDP2 # WDP1 # WDP0 #  Время тайм-аута  #
clr R17									;#  0   #   0  #   0  # 16.3мс.	(17.3мс.) #
										;#  0   #   0  #   1  # 32.5мс.	(34.3мс.) #
										;#  0   #   1  #   0  # 65мс.	(68.5мс.) #
										;#  0   #   1  #   1  # 130мс.	(140мс.)  #
										;#  1   #   0  #   0  # 260мс.	(270мс.)  #
										;#  1   #   0  #   1  # 520мс.	(550мс.)  #
										;#  1   #   1  #   0  # 1000мс.	(1100мс.) #
										;#  1   #   1  #   1  # 2100мс.	(2200мс.) #

					;Данные типовые значения соответствуют Vcc=5В.
					;При Vcc=3В типовые значения приведены в скобках.


;*********************************************************************************************


;*********************************************************************************************

;Начало Рабочей процедуры.

Start: 				;Рабочая процедура.

sei					;Разрешаем прерывания. Следующая за SEI инструкция будет выполнена
					;перед отработкой любого отложенного прерывания.

wdr					;Сбрасываем сторожевой таймер.


jmp Start			;В начало.

;*********************************************************************************************

RESET:				

jmp Init

;****************************************************

EXT_INT0:		;Программа обработчик "Внешнего прерывание 0".
cli				;На время выполнения прерывания запретим другие прерывания.
				
				
jmp Start		;Возвращаемся к Рабочеи процедуре.

;****************************************************

EXT_INT1:		;Программа обработчик "Внешнего прерывание 1".
cli				;На время выполнения прерывания запретим другие прерывания.
				
				
jmp Start		;Возвращаемся к Рабочеи процедуре.

;****************************************************

TIM2_COMP:		;Программа обработчик "Совпадение таймера T2".
cli				;На время выполнения прерывания запретим другие прерывания.
				
				
jmp Start		;Возвращаемся к Рабочеи процедуре.

;****************************************************

TIM2_OVF:		;Программа обработчик "Переполнение таймера T2".
cli				;На время выполнения прерывания запретим другие прерывания.
				
				
jmp Start		;Возвращаемся к Рабочеи процедуре.

;****************************************************

TIM1_CAPT:		;Программа обработчик "Захват таймера T1".
cli				;На время выполнения прерывания запретим другие прерывания.
				
				
jmp Start		;Возвращаемся к Рабочеи процедуре.

;****************************************************

TIM1_COMPA:	;Программа обработчик "Совпадение A таймера T1".
cli				;На время выполнения прерывания запретим другие прерывания.
				
				
jmp Start		;Возвращаемся к Рабочеи процедуре.

;****************************************************

TIM1_COMPB:	;Программа обработчик "Совпадение B таймера T1".
cli				;На время выполнения прерывания запретим другие прерывания.
				
				
jmp Start		;Возвращаемся к Рабочеи процедуре.

;****************************************************

TIM1_OVF:		;Программа обработчик "Переполнение таймера T1".
cli				;На время выполнения прерывания запретим другие прерывания.
				
				
jmp Start		;Возвращаемся к Рабочеи процедуре.

;****************************************************

TIM0_OVF:		;Программа обработчик "Переполнение таймера T0".
cli				;На время выполнения прерывания запретим другие прерывания.
				
				
jmp Start		;Возвращаемся к Рабочеи процедуре.

;****************************************************

SPI_STC:		;Программа обработчик "Передача по SPI завершена".
cli				;На время выполнения прерывания запретим другие прерывания.
				
				
jmp Start		;Возвращаемся к Рабочеи процедуре.

;****************************************************

USART_RXC:		;Программа обработчик "USART, прием завершен".
cli				;На время выполнения прерывания запретим другие прерывания.
				
				
jmp Start		;Возвращаемся к Рабочеи процедуре.

;****************************************************

USART_UDRE:		;Программа обработчик "Регистр данных USART пуст".
cli				;На время выполнения прерывания запретим другие прерывания.
				
				
jmp Start		;Возвращаемся к Рабочеи процедуре.

;****************************************************

USART_TXC:		;Программа обработчик "USART, передача завершена".
cli				;На время выполнения прерывания запретим другие прерывания.
				
				
jmp Start		;Возвращаемся к Рабочеи процедуре.

;****************************************************

ANDICON:		;Программа обработчик "Преобразование АЦП завершено".
cli				;На время выполнения прерывания запретим другие прерывания.
				
				
jmp Start		;Возвращаемся к Рабочеи процедуре.

;****************************************************

EE_RDY:			;Программа обработчик "Готовность EEPROM".
cli				;На время выполнения прерывания запретим другие прерывания.
				
				
jmp Start		;Возвращаемся к Рабочеи процедуре.

;****************************************************

ANA_COMP:		;Программа обработчик "Аналоговый компаратор".
cli				;На время выполнения прерывания запретим другие прерывания.
				
				
jmp Start		;Возвращаемся к Рабочеи процедуре.

;****************************************************

TWSI:			;Программа обработчик "Прерывание от модуля TWI".
cli				;На время выполнения прерывания запретим другие прерывания.
				
				
jmp Start		;Возвращаемся к Рабочеи процедуре.

;****************************************************

EXT_INT2:			;Программа обработчик "Внешнего прерывание 2".
cli				;На время выполнения прерывания запретим другие прерывания.
				
				
jmp Start		;Возвращаемся к Рабочеи процедуре.

;****************************************************

TIM0_COMP:		;Программа обработчик "Совпадение таймера T0".
cli				;На время выполнения прерывания запретим другие прерывания.
				
				
rjmp Start		;Возвращаемся к Рабочеи процедуре.

;****************************************************


SPM_RDY:		;Программа обработчик "Готовность SPM".
cli				;На время выполнения прерывания запретим другие прерывания.
				
				
jmp Start		;Возвращаемся к Рабочеи процедуре.

;****************************************************
;*********************************************************************************************

//Write EEPROM.//
.eseg	

;Распологаем с нулевого адреса справочную информацию.
.db 'A','v','t','o','r',':',' ',' ','O','r','f','a','n','i','d','i'
.db 'P','r','o','g','.','D','a','t','a',':',' ','0','4','.','1','1'
.db 'H','a','r','d','.','D','a','t','a',':',' ','0','4','.','1','1'
.db 'P','r','o','g','.','V','e','r','.',':',' ','0','1','.','0','1'
.db 'H','a','r','d','.','V','e','r','.',':',' ','0','1','.','0','1'
.db 'D','e','v','i','c','e',':','A','T','m','e','g','a',' ','1','6'
.db 'F','r','e','q','.',':',' ',' ',' ',' ','1','.','0','M','H','z'
.db 'S','N',':',' ',' ',' ',' ',' ','0','0','-','0','0','-','0','0'
.db 'C','o','m','m','e','n','t','s',':',' ',' ',' ',' ',' ',' ','.'
.db ' ',' ',' ',' ','.',' ',' ',' ',' ','.',' ',' ',' ',' ',' ','.'
.db ' ',' ',' ',' ',' ',' ',' ',' ',' ',' ',' ',' ','.','E','N','D'

;*********************************************************************************************

;*END*END*END*END*END*END*END*END*END*END*END*END*END*END*END*END*END*END*END*END*END*END*END*

